#include "Display_Waveshare_st7789.h"


SquareDisplay::SquareDisplay()
{

  tft = new Adafruit_ST7789(TFT_CS, TFT_DC, TFT_RS);
    mBrightness = 100;
  OldNumSets = -15;
  mOldModifyButtonState = 0;
  counter = 10;
  mBottomtext = BottomText::Helligkeit;
  m_lines_allready_erased = false;

}
void SquareDisplay::InitDisplay() {
   Serial.println("USing Square Display 3");
  tft->init(240,320);
  Serial.println("USing Square Display 2");
  tft->setRotation(1);
  #ifdef DisplayRotation180
  tft->setRotation(3);
  #endif
    canvas = new GFXcanvas1(56, 42);
  canvas_single = new GFXcanvas1(32, 36);
  canvas_history = new GFXcanvas1(105, 20);
  canvas_beachfreunde = new GFXcanvas1(220, 20);
  canvas_team1 = new GFXcanvas1(150, 60);

  tft->fillScreen(KC_grey);
  //tft.fillRect(0, 90, 240, 240, KC_dirty_white);
  tft->fillCircle(60, 180, 90, KC_DARKGREY);
  tft->fillCircle(260, 180, 90, KC_DARKGREY);


  tft->fillCircle(60, 180, 88, KC_dirty_white);
  tft->fillCircle(260, 180, 88, KC_dirty_white);

  tft->fillRect(60, 90, 180, 240, KC_dirty_white);
  tft->fillRect(60, 90, 180, 1, KC_DARKGREY);
  /* start here*/
  //border
  tft->fillCircle(100, 90, 27, KC_DARKGREY);
  tft->fillCircle(220, 90, 27, KC_DARKGREY);
  tft->fillRect(100, 63, 120, 55, KC_DARKGREY);
  //real obj
  

  tft->fillCircle(100, 90, 25, KC_BackgroundColor);
  tft->fillCircle(220, 90, 25, KC_BackgroundColor);
  //tft.drawRect(60, 85, 100, 30, TFT_RED);
  tft->fillRect(100, 65, 120, 51, KC_BackgroundColor);

  // In code later:
  //debug lines
  //tft->drawLine(40, 0, 40, 240, KC_red);
  //tft.drawLine(0, 120, 240, 120, KC_red);
    //tft->drawLine(280, 0, 280, 240, KC_red);
      //tft.drawLine(100, 0, 100, 240, KC_red);
  //double point
  tft->setTextSize(1);
  tft->setFont(&FreeSansBold18pt7b);
  tft->setCursor(157, 45);
  tft->print(":");
  tft->setCursor(155, 100);
  tft->setFont(&FreeSansBold24pt7b);
  tft->print(":");
  DrawVolleyball();
  DrawFox();
  //SetTeam1();
  //SetTeam2();
  VolleyBallHistory lol[10]; 
  bool lol2 = false;
  DrawOnDisplay(lol,0,0,0,0,true,lol2);

  
  Serial.println("Init Display Finished");
  //SetTeam1();
  //SetTeam2();
  UpdateSetCounter(0,0);
}

void SquareDisplay::DrawOnDisplay(VolleyBallHistory MyVolleyHistory[10],int setleft,int setright,int leftscore,int rightscore,bool NeedToUpdateSet,bool &DoNotUpdateHistoryOnDisplay)
{
  Serial.println("DrawOnDisplay started");
  int counterItems = 0;
  for (int t = 0; t < 10; t++) {
    if (MyVolleyHistory[t].Set == true)
      counterItems++;
  }
   Serial.println("DrawOnDisplay 1");
  UpdateScore(leftscore,rightscore);
  bool HistoryUpdated = false;
  if (NeedToUpdateSet) {
     Serial.println("DrawOnDisplay 2");
    UpdateSetCounter(setleft,setright);
    OldNumSets = setleft + setright;
    if (!DoNotUpdateHistoryOnDisplay)

    {
       Serial.println("DrawOnDisplay 3");
      HistoryUpdated = UpdateHistory(MyVolleyHistory);
      NeedToUpdateSet = false;
    } else {
      DoNotUpdateHistoryOnDisplay = false;
      NeedToUpdateSet = false;
       Serial.println("DrawOnDisplay 4");
      return;
    }
    
  }
   Serial.println("DrawOnDisplay 5");
  DoNotUpdateHistoryOnDisplay = false;
  //UpdateHistory();
  if (mOldModifyButtonState == ModifyButtonState) {
    return;
  }
  mOldModifyButtonState = ModifyButtonState;
  if (!HistoryUpdated) {
     Serial.println("DrawOnDisplay 6");
    UpdateHistory(MyVolleyHistory);
  }
  Serial.println("DrawOnDisplay finished");
}
void SquareDisplay::DrawVolleyball() {

  uint16_t volleyball[] = {
  61309, 61309, 61309, 61309, 61309, 61309, 61309, 61309, 61309, 61309, 61309, 61309,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 61309
  };
  int m_counter = 0;
  int X_vol = 10;
  int Y_vol = 115;
  int NewY = 0;
  int NewX = 0;
  for (int i = 0; i < 2500; i++) {
    if (m_counter >= 50) {
      m_counter = m_counter - 1;
      NewY++;
      NewX = 0;
      m_counter = 0;
    }
    /*if(i % 35 == 0)
  {
    Serial.print("i is ");
     Serial.print(i);
     Serial.print(" ");
     Serial.print(int(NewX+X_vol));
     Serial.print(" ");
     Serial.println(int(NewY+Y_vol));
  }*/
    if (61309 != volleyball[i])
      tft->drawPixel(NewX + X_vol, NewY + Y_vol, volleyball[i]);
    NewX++;
    m_counter++;
  }
}

void SquareDisplay::DrawFox() {

  uint16_t fox_pic[] = {
  61309, 61309, 61309, 61309, 61309, 61309, 61309, 61309, 61309, 61309, 61309, 61309,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 61309
};
  int m_counter = 0;
  int X_vol = 175+80;
  int Y_vol = 115;
  int NewY = 0;
  int NewX = 0;
  //53 * 50
  for (int i = 0; i < 2650; i++) {
    if (m_counter >= 53) {
      m_counter = m_counter - 1;
      NewY++;
      NewX = 0;
      m_counter = 0;
    }
    if (61309 != fox_pic[i])
      tft->drawPixel(NewX + X_vol, NewY + Y_vol, fox_pic[i]);
    NewX++;
    m_counter++;
  }
}

void SquareDisplay::UpdateSetCounter(int leftnum,int rightnum) {
  canvas_single->setFont(&FreeSansBold18pt7b);
  canvas_single->setTextSize(1);
  canvas_single->fillScreen(0);     // Clear canvas (not display)
  canvas_single->setCursor(0, 25);  // Pos. is BASE LINE when using fonts!

  canvas_single->print(leftnum);
  tft->drawBitmap(82+40, 25, canvas_single->getBuffer(), canvas_single->width(), canvas_single->height(), KC_dirty_white, KC_grey);

  canvas_single->fillScreen(0);     // Clear canvas (not display)
  canvas_single->setCursor(0, 25);  // Pos. is BASE LINE when using fonts!

  canvas_single->print(rightnum);
  tft->drawBitmap(140+40, 25, canvas_single->getBuffer(), canvas_single->width(), canvas_single->height(), KC_dirty_white, KC_grey);
  SetCounterLeft = leftnum;
  SetCounterRight = rightnum;
}

void SquareDisplay::UpdateScore(int left,int right) {
  canvas->setFont(&FreeSansBold24pt7b);
  char ReturnMe[2];
  canvas->setTextSize(1);
  canvas->fillScreen(0);     // Clear canvas (not display)
  canvas->setCursor(0, 35);  // Pos. is BASE LINE when using fonts!
  ConvertIntToStringWithDoubleDigit(ReturnMe, left);
  canvas->print(ReturnMe);
  // Copy canvas to screen at upper-left corner. As written here,
  // assumes a color LCD, hence the color values of 0xFFFF (white)
  // for foreground, 0x0000 (black) for background. Mono OLED can
  // use 1 and 0. BOTH colors must be specified to overwrite the
  // prior screen contents there.
  tft->drawBitmap(50+40, 68, canvas->getBuffer(),
                 canvas->width(), canvas->height(), KC_dirty_white, KC_BackgroundColor);
  canvas->fillScreen(0);     // Clear canvas (not display)
  canvas->setCursor(0, 35);  // Pos. is BASE LINE when using fonts!
  ConvertIntToStringWithDoubleDigit(ReturnMe, right);
  canvas->print(ReturnMe);
  counter++;
  if (counter > 99)
    counter = 10;
  tft->drawBitmap(135+40, 68, canvas->getBuffer(),
                 canvas->width(), canvas->height(), KC_dirty_white, KC_BackgroundColor);
}

bool SquareDisplay::ClearAndUpdateHistory()
{
    mBottomtext = BottomText::Reset;
      canvas_history->fillScreen(0);     // Clear canvas (not display)
      for(int i =0; i< 6;i++)
      {

          tft->drawBitmap(67, 118 + 21 * (i), canvas_history->getBuffer(),
          canvas_history->width(), canvas_history->height(), KC_grey, KC_dirty_white);
      }
      switch (ModifyButtonState) {
    case 0:
      {
        DrawBeachfreunde(true);
        return true;
      }
    case 1:
      {
        DrawFarbe(false);
        return true;
      }
    case 2:
      {
        DrawSets();
        return true;
      }
    case 3:
      {
        DrawFarbe(true);
        return true;
      }
    case 4:
      {
        DrawBrightness();
        //Helligkeit
        //DrawOnDisplayMode4();
        return true;
      }
    default:
      {
        return true;
      }
  }
  return true;
}

bool SquareDisplay::UpdateHistory(VolleyBallHistory History[10]) {
  Serial.println("Update History");
  int counterItems = 0;
  int currentItems = 0;
  bool m_eraseLines = false; 
  for (int t = 0; t < 10; t++) {
    if (History[t].Set == true)
      counterItems++;
  }
  
  char ReturnLeft[2];
  char ReturnRight[2];
  char ReturnSentenceTotal[1];
  canvas_history->setTextSize(1);
  canvas_history->setFont(&FreeSansBold12pt7b);
  for (int i = 0; i < 10; i++) {
    if (History[i].Set == false) {
      continue;
    } else {
      currentItems++;
    }
    if (currentItems == 5)  //clear beach freunde
    {
        //clear space
        m_eraseLines = true;
        //if(!m_lines_allready_erased ) //doesnt work :(
        {
        canvas_beachfreunde->fillScreen(0);  // Clear canvas (not display)
        tft->drawBitmap(51, 210, canvas_beachfreunde->getBuffer(), canvas_beachfreunde->width(), canvas_beachfreunde->height(), KC_dirty_white, KC_dirty_white);

        //tft->drawBitmap(37, 221, canvas_beachfreunde->getBuffer(), canvas_beachfreunde->width(), canvas_beachfreunde->height(), KC_dirty_white, KC_dirty_white);
       /* if(ModifyButtonState == 0) //clear old state
        {
          canvas_beachfreunde->fillScreen(0);
            tft->drawBitmap(37, 185, canvas_beachfreunde->getBuffer(),
                 canvas_beachfreunde->width(), canvas_beachfreunde->height(), KC_dark_blue, 100);
            tft->drawBitmap(95, 210, canvas_beachfreunde->getBuffer(), canvas_beachfreunde->width(), canvas_beachfreunde->height(), KC_dark_blue, 200);
        }*/
        }
       }
    if (ModifyButtonState > 0 && currentItems >= 5)
    {
      canvas_history->fillScreen(0);     // Clear canvas (not display)
       tft->drawBitmap(115, 198, canvas_history->getBuffer(),canvas_history->width(), canvas_history->height(), KC_grey, KC_dirty_white);
       tft->drawBitmap(115, 218, canvas_history->getBuffer(),canvas_history->width(), canvas_history->height(), KC_grey, KC_dirty_white);
      break;  //we need that extra space
    }

    canvas_history->fillScreen(0);     // Clear canvas (not display)
    canvas_history->setCursor(0, 19);  // Pos. is BASE LINE when using fonts!

    ConvertIntToStringWithDoubleDigit(ReturnLeft, History[i].Team1);
    ConvertIntToStringWithDoubleDigit(ReturnRight, History[i].Team2);
    //Serial.print(ReturnRight);
    //Serial.print(MyVolleyHistory[i].Team2);
    canvas_history->print("(");
    itoa(currentItems, ReturnSentenceTotal, 10);
    canvas_history->print(ReturnSentenceTotal);
    canvas_history->print(")");
    canvas_history->setCursor(35, 19);
    canvas_history->print(ReturnLeft);
    canvas_history->setCursor(65, 19);
    canvas_history->print(":");
    canvas_history->setCursor(75, 19);
    canvas_history->print(ReturnRight);
    tft->drawBitmap(115, 118 + 20 * (currentItems - 1), canvas_history->getBuffer(),
                   canvas_history->width(), canvas_history->height(), KC_grey, KC_dirty_white);
  }
  m_lines_allready_erased = m_eraseLines;
  switch (ModifyButtonState) {
    case 0:
      {
        if (currentItems < 4 && ModifyButtonState == 0)
          DrawBeachfreunde(true);
        return true;
      }
    case 1:
      {
        DrawFarbe(false);
        return true;
      }
    case 2:
      {
        DrawSets();
        return true;
      }
    case 3:
      {
        DrawFarbe(true);
        return true;
      }
    case 4:
      {
        DrawBrightness();
        //Helligkeit
        //DrawOnDisplayMode4();
        return true;
      }
    default:
      {
        return true;
      }
  }
  return true;
}

void SquareDisplay::DrawBeachfreunde(bool draw)  //if false we dont print
{
      if(mBottomtext == BottomText::Beachfreunde)
      {
        Serial.println("Cannot draw beachfreunde");
        return;
      }
      else
      Serial.println("draw beachfreunde");
  canvas_beachfreunde->setFont(&FreeSansBold12pt7b);
  canvas_beachfreunde->setTextSize(1);
  canvas_beachfreunde->fillScreen(0);     // Clear canvas (not display)
  canvas_beachfreunde->setCursor(0, 19);  // Pos. is BASE LINE when using fonts!
  canvas_beachfreunde->print("Beachfreunde Pohl");
  int x_off = 171;
    canvas_beachfreunde->drawPixel(x_off+24, 3, 0xFFFF);
  canvas_beachfreunde->drawPixel(x_off+24, 2, 0xFFFF);
  canvas_beachfreunde->drawPixel(x_off+ 23, 2, 0xFFFF);
  canvas_beachfreunde->drawPixel(x_off+23, 3, 0xFFFF);
  canvas_beachfreunde->drawPixel(x_off+ 18, 3, 0xFFFF);
  canvas_beachfreunde->drawPixel(x_off+ 18, 2, 0xFFFF);
  canvas_beachfreunde->drawPixel(x_off +19, 2, 0xFFFF);
  canvas_beachfreunde->drawPixel(x_off +19, 3, 0xFFFF);
  tft->drawBitmap(51, 210, canvas_beachfreunde->getBuffer(), canvas_beachfreunde->width(), canvas_beachfreunde->height(), KC_dark_blue, KC_dirty_white);
  mBottomtext = BottomText::Beachfreunde; 
}
void SquareDisplay::DrawFarbe(bool rechts)  //if false we dont print
{
  uint16_t dark_blue = tft->color565(0, 5, 170);
  uint16_t KC_dirty_white = tft->color565(238, 238, 238);
  canvas_beachfreunde->fillScreen(0);     // Clear canvas (not display)
  canvas_beachfreunde->setCursor(0, 19);  // Pos. is BASE LINE when using fonts!
  if (rechts)
  {
      if(mBottomtext ==BottomText::Farbe_rechts)
        return;
    canvas_beachfreunde->print("Farbe rechts");
    mBottomtext = BottomText::Farbe_rechts;
  }
  else
  {
    if(mBottomtext ==BottomText::Farbe_links)
        return;
    canvas_beachfreunde->print("Farbe links");
    mBottomtext = BottomText::Farbe_links;
  }
  tft->drawBitmap(51, 210, canvas_beachfreunde->getBuffer(),
                 canvas_beachfreunde->width(), canvas_beachfreunde->height(), KC_dark_blue, KC_dirty_white);
}

void SquareDisplay::DrawSets()  //if false we dont print
{
  if(mBottomtext ==BottomText::Satzverhaeltnis)
  return;
  canvas_beachfreunde->fillScreen(0);     // Clear canvas (not display)
  canvas_beachfreunde->setCursor(0, 19);  // Pos. is BASE LINE when using fonts!
  canvas_beachfreunde->print("Satzverhaltnis");
  tft->drawBitmap(51, 210, canvas_beachfreunde->getBuffer(),
                 canvas_beachfreunde->width(), canvas_beachfreunde->height(), KC_dark_blue, KC_dirty_white);
  mBottomtext = BottomText::Satzverhaeltnis;
}

void SquareDisplay::DrawBrightness() {
  //no return here because we also insert % here
  char ReturnLeft[2];
  canvas_beachfreunde->fillScreen(0);     // Clear canvas (not display)
  canvas_beachfreunde->setCursor(0, 19);  // Pos. is BASE LINE when using fonts!
  canvas_beachfreunde->print("Helligkeit: ");
  mBottomtext = BottomText::Helligkeit;
  int mBrightPercent = mBrightness / 2.55;
  if (mBrightPercent == 100)
    canvas_beachfreunde->print("100%");
  else {
    ConvertIntToStringWithDoubleDigit(ReturnLeft, mBrightPercent);
    canvas_beachfreunde->print(" ");
    canvas_beachfreunde->print(ReturnLeft);
    canvas_beachfreunde->print("%");
  }



  tft->drawBitmap(51, 210, canvas_beachfreunde->getBuffer(), canvas_beachfreunde->width(), canvas_beachfreunde->height(), KC_dark_blue, KC_dirty_white);
}


int SquareDisplay::ConvertIntToStringWithDoubleDigit(char* array, int num) {
  array[0] = '0';
  array[1] = '0';

  itoa(num, array, 10);
  if (num < 10) {

    array[1] = array[0];
    array[0] = '0';
  }
  return 1;
}

void SquareDisplay::SetBrightness(int New_Brightness)
{
  mBrightness = New_Brightness;
}
void SquareDisplay::SetModifyButtonState(int MBS)
{
  ModifyButtonState = MBS;
}

void SquareDisplay::SetTeam1()
{
    int length = sizeof("Netztester");
  strcpy(TeamName1,"Netztester");
  canvas_team1->setFont(&FreeSansBold12pt7b);
   canvas_team1->setTextSize(1);
   canvas_team1->fillScreen(0);     // Clear canvas (not display)
   canvas_team1->setCursor(0, 19);  // Pos. is BASE LINE when using fonts!
    for(int t =0; t < length;t++)
  {
     canvas_team1->print(TeamName1[t]);
    Serial.println(TeamName1[t]);
    if(t == 11)
    {
         canvas_team1->setCursor(0, 42);
    }
    if(t==20)
    break;
  }
  tft->drawBitmap(0, 0,  canvas_team1->getBuffer(),  canvas_team1->width(),  canvas_team1->height(), KC_dirty_white, KC_grey);
}

void SquareDisplay::SetTeam2()
{
  int length = sizeof("BeachPoehl");
  strcpy(TeamName1,"BeachPoehl");
   canvas_team1->setFont(&FreeSansBold12pt7b);
   canvas_team1->setTextSize(1);
   canvas_team1->fillScreen(0);     // Clear canvas (not display)
   canvas_team1->setCursor(0, 19);  // Pos. is BASE LINE when using fonts!
  Serial.print(length);
  //11
  for(int t =0; t < length;t++)
  {
     canvas_team1->print(TeamName1[t]);
    Serial.println(TeamName1[t]);
    if(t == 10)
    {
         canvas_team1->setCursor(40, 42);
    }
  }
  tft->drawBitmap(170, 0,  canvas_team1->getBuffer(),  canvas_team1->width(),  canvas_team1->height(), KC_dirty_white, KC_grey);
  
}