#include "SPI.h"
#include "Adafruit_GFX.h"
#include "Adafruit_GC9A01A.h"
#include <C:\Users\49151\Documents\Arduino\libraries\Adafruit_GFX_Library\Fonts\FreeSansBold12pt7b.h>
#include <C:\Users\49151\Documents\Arduino\libraries\Adafruit_GFX_Library\Fonts\FreeSansBold24pt7b.h>
#include <C:\Users\49151\Documents\Arduino\libraries\Adafruit_GFX_Library\Fonts\FreeSansBold18pt7b.h>
//#include <C:\Users\49151\Documents\Arduino\libraries\TJpg_Decoder\examples\FLash_array\Flash_Jpg\volleyball.h>
//#include <PNGdec.h>
// Define pins for display interface. You'll probably need to edit this for
// your own needs:


/* 50 x 50 */
uint16_t volleyball[] =
{
61309,61309,61309,61309,61309,61309,61309,61309,61309,61309,61309,61309,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61309
};
/*53 * 50*/
uint16_t fox_pic[] =
{
  61309,61309,61309,61309,61309,61309,61309,61309,61309,61309,61309,61309,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61309
};

// Other RP2040-based boards might not have "D" pin defines as shown above
// and will use GPIO bit numbers. On non-RP2040 boards, you can usually use
// pin numbers silkscreened on the board.
#define TFT_DC  7
#define TFT_CS 10
int counter= 10;
// If display breakout has a backlight control pin, that can be defined here
// as TFT_BL. On some breakouts it's not needed, backlight is always on.

/*
//Pinout
SDA - 11 (hard)
SCL - 13 (hard)
DC    7
CS    10
RS    4
*/
//GFXcanvas1 canvas_beachfreunde(160, 20);
GFXcanvas1 canvas(56, 42); // 128x32 pixel canvas
GFXcanvas1 canvas_single(32, 36); // 128x32 pixel canvas
GFXcanvas1 canvas_history(101, 20);
GFXcanvas1 canvas_beachfreunde(165, 20);
// Display constructor for primary hardware SPI connection -- the specific
// pins used for writing to the display are unique to each board and are not
// negotiable. "Soft" SPI (using any pins) is an option but performance is
// reduced; it's rarely used, see header file for syntax if needed.
Adafruit_GC9A01A tft(TFT_CS, TFT_DC,4);


void setup() {
  Serial.begin(9600);
  Serial.println("GC9A01A Test!");

  tft.begin();
  tft.setRotation(2);
  
      uint16_t grey = tft.color565(11,11,11);
  uint16_t dirty_white = tft.color565(238,238,238);
  uint16_t TFT_DARKGREY = tft.color565(125,125,125);
   uint16_t TFT_RED = tft.color565(255,0,0);
   uint16_t bluish = tft.color565(11,206,140);
  tft.fillScreen(grey);
  //tft.fillRect(0, 90, 240, 240, dirty_white);
  tft.fillCircle(60, 180, 90, TFT_DARKGREY);
  tft.fillCircle(180, 180, 90, TFT_DARKGREY);


  tft.fillCircle(60, 180, 88, dirty_white);
  tft.fillCircle(180, 180, 88, dirty_white);
  
  tft.fillRect(60, 90, 120, 240, dirty_white);

  //tft.drawLine(50, 115, 0, 240, TFT_DARKGREY);
  //tft.drawLine(190, 115, 240, 240, TFT_DARKGREY);
  //DrawVolleyball();
  //DrawFox();
    //tft.drawCircle(120, 120, 120, TFT_DARKGREY);
  //tft.drawCircle(120, 120, 119, TFT_DARKGREY);
  //tft.drawArc(120, 120, 120,119, 270, 90, TFT_DARKGREY, TFT_DARKGREY);
  
  /* start here*/
  //border
  tft.fillCircle(60, 90, 27, TFT_DARKGREY);
  tft.fillCircle(180, 90, 27, TFT_DARKGREY);
  tft.fillRect(60, 63 , 120, 55, TFT_DARKGREY);
  //real obj


  tft.fillCircle(60, 90, 25,bluish );
  tft.fillCircle(180, 90, 25,bluish );
  //tft.drawRect(60, 85, 100, 30, TFT_RED);
  tft.fillRect(60, 65, 120, 51, bluish);

// In code later:
  //debug lines
  /*tft.drawLine(120, 0, 120, 240, TFT_RED);
  tft.drawLine(0, 120, 240, 120, TFT_RED);
    tft.drawLine(140, 0, 140, 240, TFT_RED);
      tft.drawLine(100, 0, 100, 240, TFT_RED);*/
    //double point
    tft.setTextSize(1);
    tft.setFont(&FreeSansBold18pt7b);
    tft.setCursor(117,45);
    tft.print(":");
    tft.setCursor(115,100);
    tft.setFont(&FreeSansBold24pt7b);
    tft.print(":");
DrawVolleyball();
DrawFox();
  return;


}

void loop(void) {
  UpdateScore();
  delay(1000);
  UpdateHistory();
  delay(1000);
  UpdateSetCounter();
  delay(1000);
    DrawFarbe(false);
  delay(1000);
  DrawFarbe(true);
  delay(1000);
  return;
}

void UpdateSetCounter()
{
  uint16_t dirty_white = tft.color565(238,238,238);
  uint16_t grey = tft.color565(11,11,11);
    int SetL = 5;
  int SetR =3;
  canvas_single.setFont(&FreeSansBold18pt7b);
  canvas_single.setTextSize(1);
  canvas_single.fillScreen(0); // Clear canvas (not display)
  canvas_single.setCursor(0, 25); // Pos. is BASE LINE when using fonts!

  canvas_single.print(SetL);
  tft.drawBitmap(82, 25, canvas_single.getBuffer(),canvas_single.width(), canvas_single.height(), dirty_white, grey);

    canvas_single.fillScreen(0); // Clear canvas (not display)
  canvas_single.setCursor(0, 25); // Pos. is BASE LINE when using fonts!

  canvas_single.print(SetR);
  tft.drawBitmap(140, 25, canvas_single.getBuffer(),canvas_single.width(), canvas_single.height(), dirty_white, grey);

}

void UpdateScore()
{
  canvas.setFont(&FreeSansBold24pt7b);
  char ReturnMe[2];
canvas.setTextSize(1);
uint16_t bluish = tft.color565(11,206,140);
uint16_t dirty_white = tft.color565(238,238,238);
canvas.fillScreen(0); // Clear canvas (not display)
canvas.setCursor(0, 35); // Pos. is BASE LINE when using fonts!
ConvertIntToStringWithDoubleDigit(ReturnMe,20);
canvas.print(ReturnMe);
// Copy canvas to screen at upper-left corner. As written here,
// assumes a color LCD, hence the color values of 0xFFFF (white)
// for foreground, 0x0000 (black) for background. Mono OLED can
// use 1 and 0. BOTH colors must be specified to overwrite the
// prior screen contents there.
tft.drawBitmap(50, 68, canvas.getBuffer(),
canvas.width(), canvas.height(), dirty_white, bluish);
canvas.fillScreen(0); // Clear canvas (not display)
canvas.setCursor(0, 35); // Pos. is BASE LINE when using fonts!
ConvertIntToStringWithDoubleDigit(ReturnMe,counter);
canvas.print(ReturnMe);
counter++;
if(counter > 99)
counter =10;
tft.drawBitmap(135, 68, canvas.getBuffer(),
canvas.width(), canvas.height(), dirty_white, bluish);
}

void UpdateHistory()
{
        uint16_t grey = tft.color565(11,11,11);
  uint16_t dirty_white = tft.color565(238,238,238);
  int Totalsets = 3;
  char ReturnLeft[2];
  char ReturnRight[2];
  for(int i = 0; i <Totalsets;i++)
  {
 int Sentence = i+1;
  char ReturnSentenceTotal[2];
  canvas_history.setFont(&FreeSansBold12pt7b);
canvas_history.setTextSize(1);
canvas_history.fillScreen(0); // Clear canvas (not display)
canvas_history.setCursor(0, 19); // Pos. is BASE LINE when using fonts!

ConvertIntToStringWithDoubleDigit(ReturnLeft,20);
ConvertIntToStringWithDoubleDigit(ReturnRight,14);
canvas_history.print("(");
itoa(Sentence,ReturnSentenceTotal,10);
canvas_history.print(ReturnSentenceTotal);
canvas_history.print(")");
canvas_history.setCursor(35,19);
canvas_history.print(ReturnLeft);
canvas_history.setCursor(65,19);
canvas_history.print(":");
canvas_history.setCursor(75,19);
canvas_history.print(ReturnRight);
tft.drawBitmap(67, 118+21*i, canvas_history.getBuffer(),
canvas_history.width(), canvas_history.height(), grey, dirty_white);
  }
  if(Totalsets < 4)
  DrawBeachfreunde(true);
 
}

void DrawBeachfreunde(bool draw) //if false we dont print
{

          uint16_t dark_blue = tft.color565(0,5,170);
  uint16_t dirty_white = tft.color565(238,238,238);
    canvas_beachfreunde.setFont(&FreeSansBold12pt7b);
canvas_beachfreunde.setTextSize(1);
  canvas_beachfreunde.fillScreen(0); // Clear canvas (not display)
  canvas_beachfreunde.setCursor(0, 19); // Pos. is BASE LINE when using fonts!
  canvas_beachfreunde.print("Beachfreunde");
  tft.drawBitmap(37, 185, canvas_beachfreunde.getBuffer(),canvas_beachfreunde.width(), canvas_beachfreunde.height(), dark_blue, dirty_white);

  canvas_beachfreunde.fillScreen(0); // Clear canvas (not display)
  canvas_beachfreunde.setCursor(0, 19); // Pos. is BASE LINE when using fonts!
  canvas_beachfreunde.print("Pohl");
  canvas_beachfreunde.drawPixel(24,3,0xFFFF);
  canvas_beachfreunde.drawPixel(24,2,0xFFFF);
  canvas_beachfreunde.drawPixel(23,2,0xFFFF);
  canvas_beachfreunde.drawPixel(23,3,0xFFFF);
    canvas_beachfreunde.drawPixel(18,3,0xFFFF);
  canvas_beachfreunde.drawPixel(18,2,0xFFFF);
  canvas_beachfreunde.drawPixel(19,2,0xFFFF);
  canvas_beachfreunde.drawPixel(19,3,0xFFFF);
  tft.drawBitmap(95, 210, canvas_beachfreunde.getBuffer(),canvas_beachfreunde.width(), canvas_beachfreunde.height(), dark_blue, dirty_white);
}

void DrawFarbe(bool rechts) //if false we dont print
{
  uint16_t dark_blue = tft.color565(0,5,170);
  uint16_t dirty_white = tft.color565(238,238,238);
  canvas_beachfreunde.fillScreen(0); // Clear canvas (not display)
  canvas_beachfreunde.setCursor(0, 19); // Pos. is BASE LINE when using fonts!
  if(rechts)
  canvas_beachfreunde.print("Farbe rechts");
  else
  canvas_beachfreunde.print("Farbe links");
  tft.drawBitmap(37, 185, canvas_beachfreunde.getBuffer(),
canvas_beachfreunde.width(), canvas_beachfreunde.height(), dark_blue, dirty_white);

  canvas_beachfreunde.fillScreen(0); // Clear canvas (not display)
  tft.drawBitmap(95, 210, canvas_beachfreunde.getBuffer(),canvas_beachfreunde.width(), canvas_beachfreunde.height(), dark_blue, dirty_white);
}
void DrawVolleyball()
{
int m_counter;
int X_vol=15;
int Y_vol =125;
int NewY =0;
  int NewX =0;
for(int i = 0; i < 2500;i++)
{
  if(m_counter >= 50)
  {
    m_counter =m_counter -1;
    NewY++;
    NewX =0;
    m_counter = 0;
  }
  /*if(i % 35 == 0)
  {
    Serial.print("i is ");
     Serial.print(i);
     Serial.print(" ");
     Serial.print(int(NewX+X_vol));
     Serial.print(" ");
     Serial.println(int(NewY+Y_vol));
  }*/
  tft.drawPixel(NewX+X_vol, NewY+Y_vol, volleyball[i]);
  NewX++;
  m_counter++;
}
}

void DrawFox()
{
int m_counter;
int X_vol=170;
int Y_vol =125;
int NewY =0;
  int NewX =0;
  //53 * 50
for(int i = 0; i < 2650;i++)
{
  if(m_counter >= 53)
  {
    m_counter =m_counter -1;
    NewY++;
    NewX =0;
    m_counter = 0;
  }
  tft.drawPixel(NewX+X_vol, NewY+Y_vol, fox_pic[i]);
  NewX++;
  m_counter++;
}
}

int ConvertIntToStringWithDoubleDigit(char *array,int num)
{
  array[0] = '0';
  array[1] = '0';
  
  itoa(num,array,10);
  return 1;
}
